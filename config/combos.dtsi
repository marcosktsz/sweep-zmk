/*                KEY POSITIONS

  ╭──────────────────────╮ ╭──────────────────────╮
  │  0   1   2   3   4   │ │  5   6   7   8   9   │
  │ 10  11  12  13  14   │ │ 15  16  17  18  19   │
  │ 20  21  22  23  24   │ │ 25  26  27  28  29   │
  ╰───────╮ 30  31       │ │      32  33 ╭────────╯
          ╰──────────────╯ ╰─────────────╯

  Using urob-style naming:
  ╭─────────────────────╮ ╭─────────────────────╮
  │ LT4 LT3 LT2 LT1 LT0 │ │ RT0 RT1 RT2 RT3 RT4 │
  │ LM4 LM3 LM2 LM1 LM0 │ │ RM0 RM1 RM2 RM3 RM4 │
  │ LB4 LB3 LB2 LB1 LB0 │ │ RB0 RB1 RB2 RB3 RB4 │
  ╰───────╮ LH1 LH0     │ │     RH0 RH1 ╭───────╯
          ╰─────────────╯ ╰─────────────╯ */

// Sweep 34-key mapping:
// LT4=0  LT3=1  LT2=2  LT1=3  LT0=4  | RT0=5  RT1=6  RT2=7  RT3=8  RT4=9
// LM4=10 LM3=11 LM2=12 LM1=13 LM0=14 | RM0=15 RM1=16 RM2=17 RM3=18 RM4=19
// LB4=20 LB3=21 LB2=22 LB1=23 LB0=24 | RB0=25 RB1=26 RB2=27 RB3=28 RB4=29
//        LH1=30 LH0=31                |        RH0=32 RH1=33


#define COMBO_IDLE_FAST 150
#define COMBO_IDLE_SLOW 50

// Define layer numbers - adjust these to match your keymap
#define DEF 0  // default layer
#define LOW 1  // lower layer
#define RSE 2  // raise layer
#define MED 3  // media layer

/ {
    combos {
        compatible = "zmk,combos";

        combo_tab {
            timeout-ms = <30>;
            require-prior-idle-ms = <COMBO_IDLE_SLOW>;
            key-positions = <1 2>;
            bindings = <&kp TAB>;
        };
    };
};
